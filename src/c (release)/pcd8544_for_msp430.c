#include "pcd8544_for_msp430.h"

// font map - used the Minecraft font :)
const unsigned char table[480] = { 0x00, 0x00, 0x00, 0x00, 0x00, // 20
		0x00, 0x00, 0x5f, 0x00, 0x00, // 21 !
		0x04, 0x03, 0x04, 0x03, 0x00, // 22 "
		0x14, 0x7f, 0x14, 0x7f, 0x14, // 23 #
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		0x02, 0x01, 0x01, 0x02, 0x01, // 7e ~
		};

void wait(volatile unsigned int ms) {
	do
		ms--;
	while (ms != 0);
}

void nokia_init(void) {
	wait(10000);
	P1OUT = P1OUT | nok_dc; // set high
	wait(10000); //normal value 100
	P1OUT = P1OUT & ~nok_reset; // set low
	wait(10000); //normal value 100
	P1OUT = P1OUT | nok_reset; // set high
	nokia_send_cmd(0x21); // Setting LCD extended command mode
	nokia_send_cmd(0xB9); // Setting Vop contrast at 0xB9 for 3VDC
	nokia_send_cmd(0x13); // Sets LCD bias to 1:48
	nokia_send_cmd(0x20); // Set LCD to interpret display data left to right
	nokia_send_cmd(0x09); // Activate the display
	wait(1000); //normal value 100
	nokia_ddram_clear(); // Purge the DDRAM display buffer
	wait(1000); //normal value 100
	nokia_send_cmd(0x08); // Clears the screen
	wait(1000); //normal value 100
	nokia_send_cmd(0x0C); // Sets LCD normal mode
}

void nokia_ddram_clear(void) {
	int ddram;
	nokia_goto_cursor(0, 0); //writes 84*6 bit area (504 bits) with zero
	for (ddram = 0; ddram < 504; ddram++)
		nokia_write_data(0x00);
}

void nokia_send_cmd(char nokia_command) {
	P1OUT = P1OUT & ~nok_dc; // Sets the D/C pin to 0
	nokia_send_byte(nokia_command);
}

void nokia_write_data(char nokia_data) {
	P1OUT = P1OUT | nok_dc; // Sets the D/C pin to 1
	nokia_send_byte(nokia_data);
}

void nokia_send_byte(char byte_nokia) // Sends LCD byte data
{
	char i;
	for (i = 8; i > 0; i--) {
		P1OUT = P1OUT & ~nok_sclk;
		if ((byte_nokia & 0x80) == 0) {
			P1OUT = P1OUT & ~nok_sdin; // set bit low
		} else {
			P1OUT = P1OUT | nok_sdin; // set bit high
		}
		P1OUT = P1OUT | nok_sclk; // set bit high
		byte_nokia = byte_nokia << 1;
		wait(10);
	}
}

void nokia_goto_cursor(char xnokia, char ynokia) // Scrolls to cursor
{
	nokia_send_cmd(0x40 | (ynokia & 0x07)); // Moves Y cursor: 0100 0yyy
	nokia_send_cmd(0x80 | (xnokia & 0x7F)); // Moves X cursor: 1xxx xxxx
}

void nokia_contrast(char contrast) {
	nokia_send_cmd(0x21); // Sets LCD extended command
	nokia_send_cmd(0x80 | contrast); // Sets contrast
	nokia_send_cmd(0x20); // Sets horizontal addressing
}

void nokia_print_string(const char *s) {
	while (*s)
		nokia_print_char(*s++);
}

void nokia_print_char(char charsel) // Prints one character on screen
{
	char char_row, chardata;
	unsigned int charpos;

	if (charsel < 0x20)
		return;
	if (charsel > 0x7f)
		return;

	for (char_row = 0; char_row < 5; char_row++) {

		charpos = (charsel - 0x20) * 5;
		chardata = table[(charpos + char_row)];
		nokia_write_data(chardata); // Writes character data
	}
	nokia_write_data(0x00); // Sends 0x00
}

void lcdpixel(char x, char y) {
	char offset, data;

	if (x > 84)
		return;
	if (y > 48)
		return;

	offset = y - ((y / 8) * 8);
	data = (0x01 << offset);

	nokia_goto_cursor(x, (y / 6));
	nokia_write_data(data);
}

void draw_image(const unsigned char *img_ptr) {
	int i = 504;
	nokia_goto_cursor(0, 0);
	for(; i != 0; i--){
		nokia_write_data(*img_ptr++); // Writes character data
	}
}
